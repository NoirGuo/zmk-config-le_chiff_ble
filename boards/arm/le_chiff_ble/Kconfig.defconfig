## boards/arm/le_chiff_ble/Kconfig.defconfig
```kconfig
# Copyright (c) 2021 @MangoIV
# SPDX-License-Identifier: MIT

if BOARD_LE_CHIFF_BLE

config BOARD
	default "le_chiff_ble"

config ZMK_KEYBOARD_NAME
	default "Le Chiffre"

endif # BOARD_LE_CHIFF_BLE

if ZMK_BACKLIGHT

config PWM
	default y

config LED_PWM
	default y

endif # ZMK_BACKLIGHT
```

## boards/arm/le_chiff_ble/Kconfig.le_chiff_ble
```kconfig
# Copyright (c) 2021 @MangoIV
# SPDX-License-Identifier: MIT

config BOARD_LE_CHIFF_BLE
	bool "le_chiff_ble"
	select SOC_NRF52840_QIAA
	select ZMK_BOARD_COMPAT
	imply RETAINED_MEM
	imply RETENTION
	imply RETENTION_BOOT_MODE
```

## boards/arm/le_chiff_ble/board.yml
```yaml
board:
  name: le_chiff_ble
  full_name: le_chiff_ble
  vendor: eyelash
  socs:
    - name: nrf52840
```

## boards/le_chiff_ble/Kconfig.shield
```kconfig
# Copyright (c) 2021 @MangoIV
# SPDX-License-Identifier: MIT

config SHIELD_LE_CHIFF_BLE
	def_bool $(shields_list_contains,le_chiff_ble)
```
